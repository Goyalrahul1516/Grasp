## node_1_only_sht/build/Kconfig/Kconfig.shield
```kconfig
osource "c:/ncs/v2.6.1/zephyr/samples/basic/sht408/boards/shields/*/Kconfig.shield"
osource "C:/ncs/v2.6.1/nrf/boards/shields/*/Kconfig.shield"
```

## node_1_only_sht/build/Kconfig/Kconfig.shield.defconfig
```kconfig
osource "c:/ncs/v2.6.1/zephyr/samples/basic/sht408/boards/shields/*/Kconfig.defconfig"
osource "C:/ncs/v2.6.1/nrf/boards/shields/*/Kconfig.defconfig"
```
